## examples/esp32_bench_hornet/sdkconfig.defaults
```kconfig
# Target: ESP32 / ESP32-PICO-D4 (Xtensa LX6, dual-core, 240 MHz)
CONFIG_IDF_TARGET="esp32"

# Optimizer - performance for accurate benchmarks
CONFIG_COMPILER_OPTIMIZATION_PERF=y
# Run on single core — bench is single-threaded, avoids SMP race in IDF v5.4
CONFIG_FREERTOS_UNICORE=y
CONFIG_ESP_DEFAULT_CPU_FREQ_MHZ_240=y

# Stack sizes
CONFIG_ESP_MAIN_TASK_STACK_SIZE=65536
CONFIG_FREERTOS_IDLE_TASK_STACKSIZE=8192

# Flash size (PICO-D4 has 4MB embedded flash)
CONFIG_ESPTOOLPY_FLASHSIZE_4MB=y

# Logging
CONFIG_BOOTLOADER_LOG_LEVEL_WARN=y
CONFIG_LOG_DEFAULT_LEVEL_INFO=y

# IPC task stack
CONFIG_ESP_IPC_TASK_STACK_SIZE=8192

# Disable IDLE watchdog (long benchmarks)
CONFIG_ESP_TASK_WDT_CHECK_IDLE_TASK_CPU0=n
CONFIG_ESP_TASK_WDT_CHECK_IDLE_TASK_CPU1=n
```

## examples/esp32c6_bench_hornet/sdkconfig.defaults
```kconfig
# Target: ESP32-C6 (RISC-V single-core, 160 MHz)
CONFIG_IDF_TARGET="esp32c6"

# Optimizer - performance for accurate benchmarks
CONFIG_COMPILER_OPTIMIZATION_PERF=y
CONFIG_ESP_DEFAULT_CPU_FREQ_MHZ_160=y

# Stack sizes (crypto needs more stack)
CONFIG_ESP_MAIN_TASK_STACK_SIZE=65536
CONFIG_FREERTOS_IDLE_TASK_STACKSIZE=8192

# Flash size
CONFIG_ESPTOOLPY_FLASHSIZE_4MB=y

# Logging
CONFIG_BOOTLOADER_LOG_LEVEL_WARN=y
CONFIG_LOG_DEFAULT_LEVEL_INFO=y

# IPC task stack
CONFIG_ESP_IPC_TASK_STACK_SIZE=4096

# Disable IDLE watchdog (long benchmarks)
CONFIG_ESP_TASK_WDT_CHECK_IDLE_TASK_CPU0=n

# Workaround: coexist firmware enables timers before FreeRTOS on ESP32-C6 rev v0.2 + IDF v5.4
# Disable WiFi/BT coexist (bench doesn't need them) to avoid spurious timer IRQs at startup
CONFIG_ESP_COEX_ENABLED=n
CONFIG_ESP_WIFI_ENABLED=n
CONFIG_BT_ENABLED=n
CONFIG_IEEE802154_ENABLED=n
# Also disable secondary USB-JTAG console
CONFIG_ESP_CONSOLE_SECONDARY_NONE=y
# Disable NVS flash — bench doesn't need it, removes nvs_page global constructor
CONFIG_NVS_FLASH=n
```

## examples/esp32p4_bench_hornet/sdkconfig.defaults
```kconfig
# Target: ESP32-P4 (RISC-V dual-core, HP core 360 MHz)
CONFIG_IDF_TARGET="esp32p4"

# Optimizer - performance for accurate benchmarks
CONFIG_COMPILER_OPTIMIZATION_PERF=y
CONFIG_ESP_DEFAULT_CPU_FREQ_MHZ_360=y

# Stack sizes (crypto needs more stack)
CONFIG_ESP_MAIN_TASK_STACK_SIZE=65536
CONFIG_FREERTOS_IDLE_TASK_STACKSIZE=8192

# Flash size
CONFIG_ESPTOOLPY_FLASHSIZE_4MB=y

# Logging
CONFIG_BOOTLOADER_LOG_LEVEL_WARN=y
CONFIG_LOG_DEFAULT_LEVEL_INFO=y

# IPC task stack
CONFIG_ESP_IPC_TASK_STACK_SIZE=8192

# Disable IDLE watchdog (long benchmarks)
CONFIG_ESP_TASK_WDT_CHECK_IDLE_TASK_CPU0=n
CONFIG_ESP_TASK_WDT_CHECK_IDLE_TASK_CPU1=n
# Note: P4 requires SMP mode (UNICORE=y causes startup assert failure)
```

## tests/esp32c6_audit/sdkconfig.defaults
```kconfig
CONFIG_PARTITION_TABLE_SINGLE_APP_LARGE=y
CONFIG_ESP_MAIN_TASK_STACK_SIZE=65536
CONFIG_ESP_TASK_WDT_TIMEOUT_S=120
```

## tests/esp32p4_audit/sdkconfig.defaults
```kconfig
# sdkconfig.defaults for esp32p4_audit
# Use the large single-app partition table (1500K app) to accommodate
# the full audit binary (~1.07 MB).
CONFIG_PARTITION_TABLE_SINGLE_APP_LARGE=y
CONFIG_ESP_MAIN_TASK_STACK_SIZE=65536
CONFIG_ESP_TASK_WDT_TIMEOUT_S=120
```
